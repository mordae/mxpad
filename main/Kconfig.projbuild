## main/Kconfig.projbuild
```kconfig
menu "MXPAD"

	menuconfig LED
		bool "Status LED (WS2812)"
		default y

	if LED
		config LED_GPIO
			int "GPIO pin"
			default 18
			range 0 46

		config LED_SATURATION
			int "Saturation"
			range 1 100
			default 100

		config LED_VALUE
			int "Maximum value"
			range 1 100
			default 15
			help
				Will be adjusted by the Light Sensor, if enabled.
	endif

	menuconfig LIGHT
		bool "Light Sensor"
		default y

	if LIGHT
		config LIGHT_CHAN
			int "ADC1 channel"
			default 0
			range 0 9
	endif

	menuconfig JOY_L
		bool "Left Joystick"
		default y

	if JOY_L
		config JOY_L_EN_GPIO
			int "GPIO to enable"
			default -1
			range -1 46
			help
				GPIO to bring high in order to enable joystick
				readings. With -1 no GPIO is enabled.

		config JOY_L_CHAN_X
			int "X-axis ADC1 channel"
			default 2
			range 0 9

		config JOY_L_INVERT_X
			bool "Invert X-axis"
			default y

		config JOY_L_CHAN_Y
			int "Y-axis ADC1 channel"
			default 3
			range 0 9

		config JOY_L_INVERT_Y
			bool "Invert Y-axis"
			default n

		config JOY_L_BTN
			int "Button GPIO"
			default 11
			range 0 46
	endif

	menuconfig JOY_R
		bool "Right Joystick"
		default y

	if JOY_R
		config JOY_R_EN_GPIO
			int "GPIO to enable"
			default -1
			range -1 46
			help
				GPIO to bring high in order to enable joystick
				readings. With -1 no GPIO is enabled.

		config JOY_R_CHAN_X
			int "X-axis ADC1 channel"
			default 4
			range 0 9

		config JOY_R_INVERT_X
			bool "Invert X-axis"
			default y

		config JOY_R_CHAN_Y
			int "Y-axis ADC1 channel"
			default 5
			range 0 9

		config JOY_R_INVERT_Y
			bool "Invert Y-axis"
			default n

		config JOY_R_BTN
			int "Button GPIO"
			default 12
			range 0 46
	endif

	menu "Buttons"
		config BTN_A
			int "GPIO for Button A"
			default 45
			range -1 46

		config BTN_B
			int "GPIO for Button B"
			default 44
			range -1 46

		config BTN_X
			int "GPIO for Button X"
			default 42
			range -1 46

		config BTN_Y
			int "GPIO for Button Y"
			default 43
			range -1 46

		config BTN_DOWN
			int "GPIO for Button DOWN"
			default 12
			range -1 46

		config BTN_RIGHT
			int "GPIO for Button RIGHT"
			default 13
			range -1 46

		config BTN_LEFT
			int "GPIO for Button LEFT"
			default 14
			range -1 46

		config BTN_UP
			int "GPIO for Button UP"
			default 15
			range -1 46

		config BTN_START
			int "GPIO for Button START"
			default 16
			range -1 46

		config BTN_SELECT
			int "GPIO for Button SELECT"
			default 39
			range -1 46

		config BTN_HOME
			int "GPIO for Button HOME"
			default 41
			range -1 46
	endmenu

	menu "Floating GPIO Pins"
		config FLOAT_GPIO_0
			bool "Float GPIO 0"
			default n

		config FLOAT_GPIO_1
			bool "Float GPIO 1"
			default n

		config FLOAT_GPIO_2
			bool "Float GPIO 2"
			default n

		config FLOAT_GPIO_3
			bool "Float GPIO 3"
			default n

		config FLOAT_GPIO_4
			bool "Float GPIO 4"
			default n

		config FLOAT_GPIO_5
			bool "Float GPIO 5"
			default n

		config FLOAT_GPIO_6
			bool "Float GPIO 6"
			default n

		config FLOAT_GPIO_7
			bool "Float GPIO 7"
			default n

		config FLOAT_GPIO_8
			bool "Float GPIO 8"
			default n

		config FLOAT_GPIO_9
			bool "Float GPIO 9"
			default n

		config FLOAT_GPIO_10
			bool "Float GPIO 10"
			default n

		config FLOAT_GPIO_11
			bool "Float GPIO 11"
			default n

		config FLOAT_GPIO_12
			bool "Float GPIO 12"
			default n

		config FLOAT_GPIO_13
			bool "Float GPIO 13"
			default n

		config FLOAT_GPIO_14
			bool "Float GPIO 14"
			default n

		config FLOAT_GPIO_15
			bool "Float GPIO 15"
			default n

		config FLOAT_GPIO_16
			bool "Float GPIO 16"
			default n

		config FLOAT_GPIO_17
			bool "Float GPIO 17"
			default n

		config FLOAT_GPIO_18
			bool "Float GPIO 18"
			default n

		config FLOAT_GPIO_19
			bool "Float GPIO 19"
			default n

		config FLOAT_GPIO_20
			bool "Float GPIO 20"
			default n

		config FLOAT_GPIO_21
			bool "Float GPIO 21"
			default n

		config FLOAT_GPIO_22
			bool "Float GPIO 22"
			default n

		config FLOAT_GPIO_23
			bool "Float GPIO 23"
			default n

		config FLOAT_GPIO_24
			bool "Float GPIO 24"
			default n

		config FLOAT_GPIO_25
			bool "Float GPIO 25"
			default n

		config FLOAT_GPIO_26
			bool "Float GPIO 26"
			default n

		config FLOAT_GPIO_27
			bool "Float GPIO 27"
			default n

		config FLOAT_GPIO_28
			bool "Float GPIO 28"
			default n

		config FLOAT_GPIO_29
			bool "Float GPIO 29"
			default n

		config FLOAT_GPIO_30
			bool "Float GPIO 30"
			default n

		config FLOAT_GPIO_31
			bool "Float GPIO 31"
			default n

		config FLOAT_GPIO_32
			bool "Float GPIO 32"
			default n

		config FLOAT_GPIO_33
			bool "Float GPIO 33"
			default n

		config FLOAT_GPIO_34
			bool "Float GPIO 34"
			default n

		config FLOAT_GPIO_35
			bool "Float GPIO 35"
			default n

		config FLOAT_GPIO_36
			bool "Float GPIO 36"
			default n

		config FLOAT_GPIO_37
			bool "Float GPIO 37"
			default n

		config FLOAT_GPIO_38
			bool "Float GPIO 38"
			default n

		config FLOAT_GPIO_39
			bool "Float GPIO 39"
			default n

		config FLOAT_GPIO_40
			bool "Float GPIO 40"
			default n

		config FLOAT_GPIO_41
			bool "Float GPIO 41"
			default n

		config FLOAT_GPIO_42
			bool "Float GPIO 42"
			default n

		config FLOAT_GPIO_43
			bool "Float GPIO 43"
			default n

		config FLOAT_GPIO_44
			bool "Float GPIO 44"
			default n

		config FLOAT_GPIO_45
			bool "Float GPIO 45"
			default n

		config FLOAT_GPIO_46
			bool "Float GPIO 46"
			default n
	endmenu
endmenu
```
